## dts/bindings/input/cirque,pinnacle-common.yaml
```yaml
properties:
  dr-gpios:
    type: phandle-array
    description: Data ready pin for the trackpad
  rotate-90:
    type: boolean
  x-invert:
    type: boolean
  y-invert:
    type: boolean
  sleep:
    type: boolean
    description: Enables an aggressive touch sleep mode, after 5 seconds of no-touch 300ms of touch will cause wake
  touch-periods:
    type: int
    default: 3
    description: Number of checks for no movement before we declare lack of touch (saves power and enables touch detection) (0 to disable)
  no-secondary-tap:
    type: boolean
  no-taps:
    type: boolean
  sensitivity:
    type: string
    enum:
      - 1x
      - 2x
      - 3x
      - 4x
    description: ADC attenuation (sensitivity) setting.
  x-axis-z-min:
    type: int
    default: 5
  y-axis-z-min:
    type: int
    default: 4
```
